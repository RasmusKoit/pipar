## config/boards/arm/pipar_chip_isp1807/Kconfig
```kconfig
config BOARD_ENABLE_DCDC
    bool "Enable DCDC mode"
    select SOC_DCDC_NRF52X
    default y
    depends on BOARD_PIPAR_CHIP_ISP1807
```

## config/boards/arm/pipar_chip_isp1807/Kconfig.board
```kconfig
config BOARD_PIPAR_CHIP_ISP1807
    bool "Pipar Chip V2"
    depends on SOC_NRF52840_QIAA
```

## config/boards/arm/pipar_chip_isp1807/Kconfig.defconfig
```kconfig
if BOARD_PIPAR_CHIP_ISP1807

config ZMK_KEYBOARD_NAME
    default "Pipar Chip V2"

if USB_DEVICE_STACK

config USB_NRFX
    default y

endif # USB_DEVICE_STACK

config BT_CTLR
    default BT

endif # BOARD_PIPAR_CHIP_ISP1807
```

## config/boards/piparkeyboards/pipar_point/Kconfig.defconfig
```kconfig
# trackpoint is on the right, so right is central

if BOARD_PIPAR_POINT_RIGHT

config ZMK_KEYBOARD_NAME
    default "Pipar Point"

config ZMK_SPLIT_ROLE_CENTRAL
    default y

endif # BOARD_PIPAR_POINT_RIGHT

if BOARD_PIPAR_POINT_LEFT || BOARD_PIPAR_POINT_RIGHT

config BOARD
    default "pipar_point"

config ZMK_SPLIT
    default y

config BT_CTLR
    default BT

if USB

config USB_NRFX
    default y

config USB_DEVICE_STACK
    default y

endif # USB

endif # BOARD_PIPAR_POINT_LEFT || BOARD_PIPAR_POINT_RIGHT
```

## config/boards/piparkeyboards/pipar_point/board.yml
```yaml
boards:
  - name: pipar_point_left
    vendor: piparkeyboards
    socs:
      - name: nrf52840
  - name: pipar_point_right
    vendor: piparkeyboards
    socs:
      - name: nrf52840
```

## config/boards/piparkeyboards/pipar_point/pipar_point_left_3_0_0_defconfig
```kconfig
# SPDX-License-Identifier: MIT

# Enable MPU
CONFIG_ARM_MPU=y

# Use pinctrl
CONFIG_PINCTRL=y

# enable GPIO
CONFIG_GPIO=y

CONFIG_USE_DT_CODE_PARTITION=y
CONFIG_BUILD_OUTPUT_UF2=y

CONFIG_MPU_ALLOW_FLASH_WRITE=y
CONFIG_NVS=y
CONFIG_SETTINGS_NVS=y
CONFIG_FLASH=y
CONFIG_FLASH_PAGE_LAYOUT=y
CONFIG_FLASH_MAP=y

CONFIG_ZMK_BLE=y

#Backlighting configuration
CONFIG_PWM=y
CONFIG_LED_PWM=y
CONFIG_ZMK_BACKLIGHT=y
CONFIG_ZMK_BACKLIGHT_BRT_START=100
CONFIG_ZMK_BACKLIGHT_AUTO_OFF_IDLE=y
```

## config/boards/shields/pipar_chip/Kconfig.defconfig
```kconfig
if SHIELD_PIPAR_CHIP

config ZMK_KEYBOARD_NAME
    default "Pipar Chip"

if ZMK_BACKLIGHT

config PWM
    default y

config LED_PWM
    default y

endif # ZMK_BACKLIGHT

endif
```

## config/boards/shields/pipar_sool/Kconfig.defconfig
```kconfig
# Dongle 

if SHIELD_PIPAR_SOOL_DONGLE || SHIELD_PIPAR_SOOL_LEFT_CENTRAL

config ZMK_KEYBOARD_NAME
    default "Pipar & Sool"

config ZMK_SPLIT_ROLE_CENTRAL
    default y

endif

if SHIELD_PIPAR_SOOL_DONGLE || SHIELD_PIPAR_SOOL_RIGHT || SHIELD_PIPAR_SOOL_LEFT || SHIELD_PIPAR_SOOL_LEFT_CENTRAL

config ZMK_SPLIT
    default y

endif
```

## config/boards/shields/pipar_sool/Kconfig.shield
```kconfig
config SHIELD_PIPAR_SOOL
    bool

config SHIELD_PIPAR_SOOL_DONGLE
    def_bool $(shields_list_contains,pipar_sool_dongle)
    select ZMK_SPLIT_ROLE_CENTRAL
    select ZMK_SPLIT
    select SHIELD_PIPAR_SOOL

config SHIELD_PIPAR_SOOL_CENTRAL
    def_bool $(shields_list_contains,pipar_sool_central)
    select ZMK_SPLIT_ROLE_CENTRAL
    select ZMK_SPLIT
    select SHIELD_PIPAR_SOOL

config SHIELD_PIPAR_SOOL_LEFT
    def_bool $(shields_list_contains,pipar_sool_left)
    select ZMK_SPLIT
    select SHIELD_PIPAR_SOOL

config SHIELD_PIPAR_SOOL_RIGHT
    def_bool $(shields_list_contains,pipar_sool_right)
    select ZMK_SPLIT
    select SHIELD_PIPAR_SOOL
```

## config/boards/shields/pipar_test/Kconfig.defconfig
```kconfig
# Dongle 

if SHIELD_PIPAR_TEST_DONGLE

config ZMK_KEYBOARD_NAME
    default "PiparTest"

config ZMK_SPLIT_ROLE_CENTRAL
    default y

config ZMK_SPLIT_BLE_CENTRAL_PERIPHERALS
    default 1

config ZMK_SPLIT
    default y
config ZMK_BLE
    default y

endif

if SHIELD_PIPAR_TEST_SLAVE

config ZMK_BLE
    default y

config ZMK_SPLIT
    default y

if ZMK_DISPLAY

config I2C
    default y

config SSD1306
    default y

endif

if LVGL

config LV_Z_VDB_SIZE
    default 64

config LV_DPI_DEF
    default 148

config LV_Z_BITS_PER_PIXEL
    default 1

choice LV_COLOR_DEPTH
    default LV_COLOR_DEPTH_1
endchoice

endif # LVGL

endif
```

## config/boards/shields/pipar_test/Kconfig.shield
```kconfig
config SHIELD_PIPAR_TEST_DONGLE
    def_bool $(shields_list_contains,pipar_test_dongle)

config SHIELD_PIPAR_TEST_SLAVE
    def_bool $(shields_list_contains,pipar_test_slave)
```

## config/west.yml
```yaml
manifest:
  remotes:
    - name: zmkfirmware
      url-base: https://github.com/zmkfirmware
    - name: petejohanson
      url-base: https://github.com/petejohanson
    - name: RasmusKoit
      url-base: https://github.com/RasmusKoit
    - name: urob
      url-base: https://github.com/urob
    - name: filippor
      url-base: https://github.com/filippor
    # Additional modules containing boards/shields/custom code can be listed here as well
    # See https://docs.zephyrproject.org/3.2.0/develop/west/manifest.html#projects
  projects:
    - name: zmk
      remote: petejohanson
      revision: core/move-to-zephyr-4-1
      import: app/west.yml
    - name: zmk-keyboard-pipar
      remote: RasmusKoit
      revision: main
    - name: zmk-unicode
      remote: urob
      revision: v0.3
    - name: kb_zmk_ps2_mouse_trackpoint_driver
      remote: filippor
      revision: badjeff-4.1
  self:
    path: config
```

## zmk-config/boards/shields/pipar_flake/Kconfig.defconfig
```kconfig
if SHIELD_PIPAR_FLAKE

config ZMK_KEYBOARD_NAME
    default "PiparFlake"

if ZMK_DISPLAY

config I2C
    default y

config SSD1306
    default y

endif


endif
```

## zmk/boards/shields/pipar/Kconfig.defconfig
```kconfig
# Dongle 

if SHIELD_PIPAR_DONGLE

config ZMK_KEYBOARD_NAME
    default "Pipar"

config ZMK_SPLIT_ROLE_CENTRAL
    default y

config ZMK_USB
    default y

endif

if SHIELD_PIPAR

config ZMK_SPLIT
    default y

config ZMK_BLE
    default y

endif
```

## zmk/boards/shields/pipar/Kconfig.shield
```kconfig
config SHIELD_PIPAR
    bool

config SHIELD_PIPAR_DONGLE
    def_bool $(shields_list_contains,pipar_dongle)
    select SHIELD_PIPAR

config SHIELD_PIPAR_LEFT
    def_bool $(shields_list_contains,pipar_left)
    select SHIELD_PIPAR

config SHIELD_PIPAR_RIGHT
    def_bool $(shields_list_contains,pipar_right)
    select SHIELD_PIPAR
```
