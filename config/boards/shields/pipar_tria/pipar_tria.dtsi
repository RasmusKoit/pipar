/*
 * Copyright (c) 2022 The ZMK Contributors
 *
 * SPDX-License-Identifier: MIT
 */

#include <dt-bindings/zmk/matrix_transform.h>

/ {
  chosen {
    zmk,kscan = &kscan0;
    zmk,matrix-transform = &default_transform;
  };

  kscan0: kscan_direct {
    compatible = "zmk,kscan-gpio-direct";
    wakeup-source;
    input-gpios
      = <&pro_micro 21 (GPIO_ACTIVE_LOW | GPIO_PULL_UP)>
      , <&pro_micro 20 (GPIO_ACTIVE_LOW | GPIO_PULL_UP)>
      , <&pro_micro 19 (GPIO_ACTIVE_LOW | GPIO_PULL_UP)>
      ;
  };

  default_transform: keymap_transform_0 {
    compatible = "zmk,matrix-transform";
    columns = <3>;
    rows = <1>;
    map = <
      RC(0, 0) RC(0, 1) RC(0, 2)
    >;
  };


};
